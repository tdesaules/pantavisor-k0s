## build/meta-k0s/conf/layer.conf
```bitbake
BBPATH .= ":${LAYERDIR}"
BBFILES += "${LAYERDIR}/recipes-*/*/*.bb ${LAYERDIR}/recipes-*/*/*.bbappend"
BBFILE_COLLECTIONS += "platformk0s"
BBFILE_PATTERN_platformk0s = "^${LAYERDIR}/"
BBFILE_PRIORITY_platformk0s = "10"
LAYERSERIES_COMPAT_platformk0s = "scarthgap"
LAYERDEPENDS_platformk0s = "core"
K0S_REPO_ROOT := "${LAYERDIR}/../.."
```

## build/meta-k0s/conf/machine/userspace-arm64.conf
```bitbake
DEFAULTTUNE = "armv8a"
require conf/machine/include/arm/arch-armv8a.inc
require conf/machine/include/bspless.inc
PREFERRED_PROVIDER_virtual/kernel = "linux-dummy"
```
